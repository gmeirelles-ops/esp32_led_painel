## main/Kconfig.projbuild
```kconfig
menu "Painel LED — configuração"

    choice PAINEL_TOPOLOGY
        prompt "Display topology"
        default PAINEL_TOPOLOGY_SINGLE
        help
            Single: one HUB75 module 128×64 (default, hardware validated).
            2×2: four 128×64 modules in a 2×2 grid (256×128 logical canvas).
            Panels chain via HUB75; LVGL resolution follows the virtual size.

        config PAINEL_TOPOLOGY_SINGLE
            bool "Single panel (128×64)"

        config PAINEL_TOPOLOGY_2X2
            bool "Four panels 2×2 (256×128)"
    endchoice

config PAINEL_WIFI_SSID
    string "Wi-Fi SSID (lab fallback quando NVS vazio)"
    default ""
    help
        Credencial de laboratório. Não commitar valores reais.

config PAINEL_WIFI_PASSWORD
    string "Wi-Fi password (lab fallback)"
    default ""
    help
        Senha de laboratório. Não commitar valores reais.

config PAINEL_POA_LAT
    float "Porto Alegre latitude"
    default -30.0346

config PAINEL_POA_LON
    float "Porto Alegre longitude"
    default -51.2177

endmenu
```

## sdkconfig.defaults
```kconfig
# Shared defaults (target chip in sdkconfig.defaults.esp32s3)

# Adafruit MatrixPortal S3 — 8 MB flash (board ships with 8 MB)
CONFIG_ESPTOOLPY_FLASHSIZE_8MB=y
CONFIG_PARTITION_TABLE_SINGLE_APP_LARGE=y
# CONFIG_PARTITION_TABLE_SINGLE_APP is not set
```

## sdkconfig.defaults.esp32s3
```kconfig
# ESP32-S3 — Adafruit MatrixPortal S3 + SXHL-P2.5-1735 (128×64, 1/32, HUB75E)
CONFIG_IDF_TARGET="esp32s3"

# Quad PSRAM (not octal — conflicts with HUB75 GPIO 35/36/37)
CONFIG_SPIRAM=y
CONFIG_SPIRAM_MODE_QUAD=y
# CONFIG_SPIRAM_MODE_OCT is not set
CONFIG_SPIRAM_TYPE_AUTO=y
CONFIG_SPIRAM_SPEED_80M=y
CONFIG_SPIRAM_USE_MALLOC=y

# Display topology — single panel default (see menuconfig for 2×2)
CONFIG_PAINEL_TOPOLOGY_SINGLE=y
# CONFIG_PAINEL_TOPOLOGY_2X2 is not set

# HUB75 — MatrixPortal preset, FM6126A, 10 MHz clock
CONFIG_HUB75_BOARD_ADAFRUIT_MATRIX_PORTAL_S3=y
CONFIG_HUB75_PANEL_WIDTH=128
CONFIG_HUB75_PANEL_HEIGHT=64
CONFIG_HUB75_DRIVER_FM6126A=y
# CONFIG_HUB75_DRIVER_GENERIC is not set
CONFIG_HUB75_CLK_10MHZ=y
# CONFIG_HUB75_CLK_20MHZ is not set
CONFIG_HUB75_BRIGHTNESS=255
CONFIG_HUB75_MIN_REFRESH_RATE=60

# LVGL dashboard
CONFIG_LV_COLOR_DEPTH_16=y
CONFIG_LV_FONT_MONTSERRAT_12=y
CONFIG_LV_FONT_MONTSERRAT_14=y
CONFIG_LV_FONT_MONTSERRAT_24=y
CONFIG_LV_FONT_MONTSERRAT_48=y

# Wi-Fi / network
CONFIG_ESP_WIFI_STA=y
CONFIG_ESP_WIFI_SOFTAP_SUPPORT=n
CONFIG_LWIP_SNTP_MAX_SERVERS=1
CONFIG_MBEDTLS_CERTIFICATE_BUNDLE=y
CONFIG_MBEDTLS_CERTIFICATE_BUNDLE_DEFAULT_FULL=y
```
